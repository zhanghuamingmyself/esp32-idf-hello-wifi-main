## main/Kconfig.projbuild
```kconfig
menu "WiFi App Configuration"

  config ESP_WIFI_SSID
      string "WiFi SSID"
      default "Hithium-SZ-guest"
      help
          WiFi SSID (network name)

  config ESP_WIFI_PASSWORD
      string "WiFi Password"
      default "hc123456"
      help
          WiFi password (for WPA / WPA2)

endmenu
```
